## CMakeLists.txt
```
cmake_minimum_required(VERSION 3.20.0)

#### Download GoogleTest with the revision (git hash) in the URL
set(CMAKE_C_FLAGS -m32)
set(CMAKE_CXX_FLAGS -m32)
# GoogleTest requires at least C++14
set(CMAKE_CXX_STANDARD 14)
set(CMAKE_CXX_STANDARD_REQUIRED ON)
set(BOARD native_posix)
include(FetchContent)
FetchContent_Declare(
  googletest
  URL https://github.com/google/googletest/archive/03597a01ee50ed33e9dfd640b249b4be3799d395.zip
)

# For Windows: Prevent overriding the parent project's compiler/linker settings
# set(gtest_force_shared_crt ON CACHE BOOL "" FORCE)

FetchContent_MakeAvailable(googletest)


# Build zephyr application
find_package(Zephyr REQUIRED HINTS $ENV{ZEPHYR_BASE})
project(hello_world)
include_directories(include)
target_sources(app PRIVATE src/main.c src/max.c)

# gtest
enable_testing()

# Compile hello_test.cpp test code to hello_test binary
add_executable(
  hello_test 
  tests/hello_test.cpp 
)

# Link hello_test to googletest library
target_link_libraries(
  hello_test
  GTest::gtest_main
)

# Link hello_test to app (which holds all the zephyr compilated stuff)
target_link_libraries(hello_test app)

include(GoogleTest)
gtest_discover_tests(hello_test)
```

## west.yml
```
manifest:
  self:
    west-commands: scripts/west-commands.yml

  remotes:
    - name: zephyrproject-rtos
      url-base: https://github.com/zephyrproject-rtos

  projects:
    - name: zephyr
      remote: zephyrproject-rtos
      revision: main
      import:
        # By using name-allowlist we can clone only the modules that are
        # strictly needed by the application.
        name-allowlist:
          - cmsis      # required by the ARM port
```

## prj.conf
```kconfig
# nothing here
# CONFIG_CPP=y
# CONFIG_STD_CPP14=y
# CONFIG_REQUIRES_FULL_LIBCPP=y
```

## src/main.c
```c
/*
 * Copyright (c) 2012-2014 Wind River Systems, Inc.
 *
 * SPDX-License-Identifier: Apache-2.0
 */

#include <stdio.h>
#include <max.h>

int main(void)
{
	printf("Hello World! %s\n", CONFIG_BOARD);

	int a = 10;
	int b = 20;
	int ret = max(a, b);

	printf("Max value: %d\n", ret);
	return 0;
}
```

## include/max.h
```c
#ifndef MAX_H
#define MAX_H

#ifdef __cplusplus
extern "C" {
#endif

int max(int a, int b);

#ifdef __cplusplus
}
#endif

#endif // MAX_H
```

## src/max.c
```c
#include <max.h>

int max(int a, int b)
{
    return a > b ? a : b;
}
```
